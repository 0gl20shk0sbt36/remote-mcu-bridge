## esp32_rom/main/Kconfig.projbuild
```kconfig
menu "RMB generic trusted-LAN resident"
config RMB_ENABLE
 bool "Enable resident network and module loader"
 default n
config RMB_WIFI_SSID
 string "Station Wi-Fi SSID"
 default ""
config RMB_WIFI_PASSWORD
 string "Station Wi-Fi password"
 default ""
config RMB_TOKEN
 string "LAN token (16-128 bytes)"
 default ""
config RMB_PORT
 int "Advertised default service port (module owns listener)"
 range 1024 65535
 default 3333
config RMB_LISTENER_STACK_BYTES
 int "Service listener task stack (bytes, per registered listener)"
 range 4096 32768
 default 12288
 help
  Includes the synchronous service callback, SDK drivers, logging and libc.
  The STM service overflowed a 6144-byte listener in real hardware tests.
  Monitor rmb-net stack_min_free_bytes after representative requests.
  Four listeners can be registered; stack allocation failure aborts init.
config RMB_DISCOVERY_PORT
 int "UDP discovery port"
 range 1024 65535
 default 3334
endmenu
rsource "../module/Kconfig.projbuild"
```

## esp32_rom/module/Kconfig.projbuild
```kconfig
menu "STM32 ROM target hardware"
choice ROM_SERVICE_DEVICE
    prompt "Target part (geometry, ID, RAM footprint)"
    default ROM_SERVICE_DEVICE_F407ZG
config ROM_SERVICE_DEVICE_F407ZG
    bool "STM32F407ZG: 1 MiB, 4x16K+64K+7x128K sectors, RAM image at 0x20004000"
config ROM_SERVICE_DEVICE_F103C8
    bool "STM32F103C8: 64 KiB, 1 KiB pages, ROM uses 512 B, RAM image at 0x20000400"
endchoice
config ROM_SERVICE_TX
    int "UART1 TX -> STM32 ROM USART RX GPIO"
    range -1 21
    default -1
config ROM_SERVICE_RX
    int "UART1 RX <- STM32 ROM USART TX GPIO"
    range -1 21
    default -1
config ROM_SERVICE_BOOT0
    int "STM32 BOOT0 GPIO"
    range -1 21
    default -1
config ROM_SERVICE_BOOT1
    int "STM32 BOOT1 GPIO (-1: externally tied low)"
    range -1 21
    default -1
config ROM_SERVICE_NRST
    int "STM32 NRST open-drain GPIO (external pull-up required)"
    range -1 21
    default -1
endmenu
```
